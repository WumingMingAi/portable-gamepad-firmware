## app/Kconfig
```kconfig
source "Kconfig.zephyr"

menu "Portable Gamepad Firmware settings"

config PGF_INPUT_MODE_DEFAULT
    int "Default input mode"
    range 1 3
    default 1
    help
        1 = Stadia
        2 = Switch
        3 = PC

config PGF_INPUT_MODE_DYNAMIC
    bool "Enable input mode switching"
    default y

config PGF_DPAD_MODES
    bool "Enable dpad mode switching"
    default y
    help
        Lets the dpad be repurposed, at startup, to drive the left or
        right analog stick instead of its own dpad input - selected by
        holding down/left/right on power-up (same mechanism as input
        mode) and persisted the same way. Must be disabled on any board
        that already has a real analog stick axis configured via
        gamepad-axes - the build fails otherwise.

config PGF_TRANSPORT_SWITCH
    bool "Three-position transport switch (BLE / ESB / USB-only)"
    default n
    help
        Reads a two-GPIO three-position switch (defined as a
        /transport-switch node with switch_a and switch_b children,
        active-low) at boot to select the wireless transport:
        switch_a grounded = BLE, switch_b grounded = ESB, neither =
        USB-only. While running, a change to the switch position
        triggers a reboot into the new transport. USB always wins when
        a cable is connected.

config PGF_ESB_DONGLE
    bool "ESB dongle mode (radio receiver + USB gamepad output)"
    depends on ESB
    default n
    help
        Turns this build into the 2.4GHz receiver side: no buttons, no
        BLE; button states and the platform arrive over ESB from the
        controller and are output over USB. The gamepad-buttons node
        must still list the same children in the same order as the
        controller build (dummy pins are fine) so button indexes match.

config PGF_PLATFORM_HOTKEY
    bool "Platform switch hotkey (hold system + west/east/south)"
    default n
    help
        Holding the system button together with west (LP), east (MK)
        or south (LK) for PGF_PLATFORM_HOTKEY_HOLD_MS switches the
        platform to PC/Switch/Stadia respectively, saves it and
        reboots. While the combination is held, the normal system
        button long-press actions (sleep / clear bonds / bootloader)
        are suppressed.

config PGF_PLATFORM_HOTKEY_HOLD_MS
    int "Platform hotkey hold time in ms"
    default 5000
    depends on PGF_PLATFORM_HOTKEY

config PGF_ESB_RF_CHANNEL
    int "ESB radio channel (0-100, 1 MHz spacing from 2400 MHz)"
    default 76
    depends on ESB

config PGF_MANUFACTURER_NAME
    string "Device manufacturer string"
    default "Arasaka"

config PGF_PRODUCT_NAME
    string "Device product name"
    default "PGF"

config PGF_GROUP_ADC_CHANNELS
    bool "Read all analog axes on the same ADC controller in one call"
    depends on ADC
    default n if ADC_SAM0
    default n if ADC_ESP32
    default y
    help
        Most ADC drivers can read several channels in one adc_read()
        call, whether through real hardware scan/sequencer support or a
        software loop the driver manages transparently. Some can't.
        Turn this off to make every analog axis use its own adc_read()
        call instead of grouping every axis on a shared controller into
        a single one.

choice PGF_BATTERY_LEVEL_REPORTING
    prompt "Battery level reporting"
    optional

config PGF_BATTERY_LEVEL_REPORTING_VBATT
    bool "Voltage divider + ADC"
    depends on ADC
    help
        Periodically samples battery voltage through a /vbatt
        voltage-divider devicetree node and reports it over the
        Bluetooth Battery Service (if enabled) and the log. The board
        must define a /vbatt node with status "okay" - the build will
        fail otherwise.

config PGF_BATTERY_LEVEL_REPORTING_PMIC
    bool "Nordic nPM13xx PMIC over I2C"
    depends on I2C
    depends on SENSOR
    help
        Periodically reads battery voltage from a Nordic nPM13xx PMIC
        over I2C and reports it over the Bluetooth Battery Service (if
        enabled) and the log. The board must define a
        "nordic,npm1300-charger" devicetree node labeled pmic_charger
        with status "okay" - the build will fail otherwise.

endchoice

endmenu
```
